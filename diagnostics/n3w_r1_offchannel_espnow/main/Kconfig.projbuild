## diagnostics/n3w_r1_offchannel_espnow/main/Kconfig.projbuild
```kconfig
menu "N3W R1 Off-Channel Baseline"

    choice R1_ROLE
        prompt "R1 board role"
        default R1_ROLE_DUT

        config R1_ROLE_DUT
            bool "DUT STA (Board B)"

        config R1_ROLE_CONTROL
            bool "Control SoftAP (Board A)"
    endchoice

endmenu
```

## diagnostics/n3w_r1r3_roc_lifecycle/main/Kconfig.projbuild
```kconfig
menu "N3W R1R3 ROC Lifecycle Baseline"

    choice R1R3_ROLE
        prompt "R1R3 board role"
        default R1R3_ROLE_DUT

        config R1R3_ROLE_DUT
            bool "DUT STA (Board B)"

        config R1R3_ROLE_CONTROL
            bool "Control SoftAP (Board A)"
    endchoice

endmenu
```

## diagnostics/n3w_r1r4_usb_console_evidence/main/Kconfig.projbuild
```kconfig
menu "N3W R1R4 USB Console Evidence Hardened ROC Lifecycle"

    choice R1R4_ROLE
        prompt "R1R4 board role"
        default R1R4_ROLE_DUT

        config R1R4_ROLE_DUT
            bool "DUT STA (Board B)"

        config R1R4_ROLE_CONTROL
            bool "Control SoftAP (Board A)"
    endchoice

endmenu
```
